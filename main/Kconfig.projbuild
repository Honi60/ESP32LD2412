## main/Kconfig.projbuild
```kconfig
menu "LD2412 radar"
    config LD2412_UART_PORT
        int "UART port connected to the LD2412"
        default 1

    config LD2412_TX_GPIO
        int "GPIO driving the LD2412 RX pin"
        default 18
        help
            Do not use GPIO16/17 on ESP32-C6: those are U0TXD/U0RXD, which the console
            drives while CONFIG_ESP_CONSOLE_UART_NUM=0, so the boot log and the radar
            traffic collide on the same pads and the radar never answers. GPIO18/19/20/23
            are free on the ESP32-C6-LCD-1.47 header.

    config LD2412_RX_GPIO
        int "GPIO reading the LD2412 TX pin"
        default 19

    config LD2412_ENGINEERING_MODE
        bool "Enable radar engineering mode at boot"
        default y
        help
            Engineering mode adds per-distance-gate energy values to every report frame
            (protocol section 2.3.2, table 13). The setting is lost when the radar loses
            power, so it is re-applied at every boot. Disable to get the shorter basic
            frames only.
endmenu
```

## sdkconfig.defaults
```kconfig
CONFIG_IDF_TARGET="esp32c6"

CONFIG_LD2412_UART_PORT=1
CONFIG_LD2412_TX_GPIO=18
CONFIG_LD2412_RX_GPIO=19
CONFIG_LD2412_ENGINEERING_MODE=y

CONFIG_LV_USE_USER_DATA=y
CONFIG_LV_USE_CHART=y
CONFIG_LV_MEM_SIZE_KILOBYTES=48

CONFIG_ESPTOOLPY_FLASHSIZE_4MB=y
CONFIG_PARTITION_TABLE_CUSTOM=y
CONFIG_MBEDTLS_HKDF_C=y
```
